/**
 * DMTFT-28 LCD驱动 (ILI9341 + FSMC)
 * 山西大学 测控技术与仪器专业
 * 前提：Keil5已导入STM32标准外设库
 */
#include "lcd.h"

/* 8x16 ASCII字库 (打印字符 32~126, 95个) */
static const uint8_t font_1608[95][16] = {
    {0x00,0x00,0x00,0x00,0x00,0x00,0x00,0x00,0x00,0x00,0x00,0x00,0x00,0x00,0x00,0x00},
    {0x00,0x00,0x00,0xF8,0x00,0x00,0x00,0x00,0x00,0x00,0x00,0x33,0x30,0x00,0x00,0x00},
    {0x00,0x10,0x0C,0x06,0x10,0x0C,0x06,0x00,0x00,0x00,0x00,0x00,0x00,0x00,0x00,0x00},
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    {0x00,0x06,0x01,0x01,0x02,0x02,0x04,0x04,0x00,0x00,0x00,0x00,0x00,0x00,0x00,0x00},
};

/* FSMC配置 */
static void LCD_FSMC_Init(void)
{
    FSMC_NORSRAMInitTypeDef f;
    FSMC_NORSRAMTimingInitTypeDef t;

    RCC_AHBPeriphClockCmd(RCC_AHBPeriph_FSMC, ENABLE);

    t.FSMC_AddressSetupTime = 1;
    t.FSMC_AddressHoldTime = 0;
    t.FSMC_DataSetupTime = 15;
    t.FSMC_BusTurnAroundDuration = 0;
    t.FSMC_CLKDivision = 0;
    t.FSMC_DataLatency = 0;
    t.FSMC_AccessMode = FSMC_AccessMode_A;

    f.FSMC_Bank = FSMC_Bank1_NORSRAM4;
    f.FSMC_DataAddressMux = FSMC_DataAddressMux_Disable;
    f.FSMC_MemoryType = FSMC_MemoryType_SRAM;
    f.FSMC_MemoryDataWidth = FSMC_MemoryDataWidth_16b;
    f.FSMC_BurstAccessMode = FSMC_BurstAccessMode_Disable;
    f.FSMC_WaitSignalPolarity = FSMC_WaitSignalPolarity_Low;
    f.FSMC_WrapMode = FSMC_WrapMode_Disable;
    f.FSMC_WaitSignalActive = FSMC_WaitSignalActive_BeforeWaitState;
    f.FSMC_WriteOperation = FSMC_WriteOperation_Enable;
    f.FSMC_WaitSignal = FSMC_WaitSignal_Disable;
    f.FSMC_ExtendedMode = FSMC_ExtendedMode_Disable;
    f.FSMC_WriteBurst = FSMC_WriteBurst_Disable;
    f.FSMC_ReadWriteTimingStruct = &t;
    f.FSMC_WriteTimingStruct = &t;
    FSMC_NORSRAMInit(&f);
    FSMC_NORSRAMCmd(FSMC_Bank1_NORSRAM4, ENABLE);
}

/* GPIO配置 */
static void LCD_GPIO_Init(void)
{
    GPIO_InitTypeDef g;
    RCC_APB2PeriphClockCmd(RCC_APB2Periph_GPIOD | RCC_APB2Periph_GPIOE |
                           RCC_APB2Periph_GPIOG | RCC_APB2Periph_GPIOB, ENABLE);

    g.GPIO_Speed = GPIO_Speed_50MHz;
    g.GPIO_Mode = GPIO_Mode_AF_PP;

    g.GPIO_Pin = 0xFF;  GPIO_Init(GPIOD, &g);  /* PD0-7 */
    g.GPIO_Pin = GPIO_Pin_14 | GPIO_Pin_15; GPIO_Init(GPIOD, &g);
    g.GPIO_Pin = 0xFF;  GPIO_Init(GPIOE, &g);  /* PE7-15 */
    g.GPIO_Pin = GPIO_Pin_0 | GPIO_Pin_12; GPIO_Init(GPIOG, &g);

    /* RST & BL */
    g.GPIO_Mode = GPIO_Mode_Out_PP;
    g.GPIO_Pin = GPIO_Pin_11; GPIO_Init(GPIOG, &g);  /* RST */
    g.GPIO_Pin = GPIO_Pin_0;  GPIO_Init(GPIOB, &g);  /* BL */
    GPIO_SetBits(GPIOB, GPIO_Pin_0);  /* 背光开 */
}

/* 写命令/数据 */
static void LCD_WR(uint16_t cmd, uint16_t dat) { LCD_CMD = cmd; LCD_DATA = dat; }
static void LCD_SetWin(uint16_t x1, uint16_t y1, uint16_t x2, uint16_t y2)
{
    LCD_WR(0x2A, x1 >> 8); LCD_WR(0x2A, x1 & 0xFF);
    LCD_WR(0x2A, x2 >> 8); LCD_WR(0x2A, x2 & 0xFF);
    LCD_WR(0x2B, y1 >> 8); LCD_WR(0x2B, y1 & 0xFF);
    LCD_WR(0x2B, y2 >> 8); LCD_WR(0x2B, y2 & 0xFF);
    LCD_CMD = 0x2C;
}

/* ILI9341初始化 */
static void LCD_ILI9341_Init(void)
{
    GPIO_ResetBits(GPIOG, GPIO_Pin_11); delay_ms(100);
    GPIO_SetBits(GPIOG, GPIO_Pin_11);   delay_ms(100);

    LCD_WR(0x01, 0x0000); delay_ms(150);  /* 软复位 */
    LCD_WR(0x11, 0x0000); delay_ms(150);  /* 退出睡眠 */

    /* 电源 */
    LCD_WR(0xCB, 0x39); LCD_WR(0xCB, 0x2C); LCD_WR(0xCB, 0x00);
    LCD_WR(0xCB, 0x34); LCD_WR(0xCB, 0x02);
    LCD_WR(0xCF, 0x00); LCD_WR(0xCF, 0xC1); LCD_WR(0xCF, 0x30);
    LCD_WR(0xE8, 0x85); LCD_WR(0xE8, 0x00); LCD_WR(0xE8, 0x78);
    LCD_WR(0xEA, 0x00); LCD_WR(0xEA, 0x00);
    LCD_WR(0xED, 0x64); LCD_WR(0xED, 0x03); LCD_WR(0xED, 0x12); LCD_WR(0xED, 0x81);
    LCD_WR(0xF7, 0x20);
    LCD_WR(0xC0, 0x23);
    LCD_WR(0xC1, 0x10);
    LCD_WR(0xC5, 0x3E); LCD_WR(0xC5, 0x28);
    LCD_WR(0xC7, 0x86);
    LCD_WR(0x36, 0x48);  /* MY=0,MX=1,MV=1,BGR=1 */
    LCD_WR(0x3A, 0x55);  /* 16-bit RGB565 */

    /* 帧率 */
    LCD_WR(0xB1, 0x00); LCD_WR(0xB1, 0x18);
    LCD_WR(0xB6, 0x08); LCD_WR(0xB6, 0x82); LCD_WR(0xB6, 0x27);

    /* Gamma */
    LCD_WR(0x26, 0x01);
    LCD_WR(0xE0, 0x0F); LCD_WR(0xE0, 0x31); LCD_WR(0xE0, 0x2B);
    LCD_WR(0xE0, 0x0C); LCD_WR(0xE0, 0x0E); LCD_WR(0xE0, 0x08);
    LCD_WR(0xE0, 0x4E); LCD_WR(0xE0, 0xF1); LCD_WR(0xE0, 0x37);
    LCD_WR(0xE0, 0x07); LCD_WR(0xE0, 0x10); LCD_WR(0xE0, 0x03);
    LCD_WR(0xE0, 0x0E); LCD_WR(0xE0, 0x09); LCD_WR(0xE0, 0x00);
    LCD_WR(0xE1, 0x00); LCD_WR(0xE1, 0x0E); LCD_WR(0xE1, 0x14);
    LCD_WR(0xE1, 0x03); LCD_WR(0xE1, 0x11); LCD_WR(0xE1, 0x07);
    LCD_WR(0xE1, 0x31); LCD_WR(0xE1, 0xC1); LCD_WR(0xE1, 0x48);
    LCD_WR(0xE1, 0x08); LCD_WR(0xE1, 0x0F); LCD_WR(0xE1, 0x0C);
    LCD_WR(0xE1, 0x31); LCD_WR(0xE1, 0x36); LCD_WR(0xE1, 0x0F);

    LCD_WR(0x11, 0x0000); delay_ms(120);
    LCD_WR(0x29, 0x0000);  /* 开显示 */
}

void LCD_Init(void)
{
    LCD_GPIO_Init();
    LCD_FSMC_Init();
    LCD_ILI9341_Init();
    LCD_Clear(WHITE);
}

void LCD_Clear(uint16_t color)
{
    uint32_t i, n = (uint32_t)LCD_W * LCD_H;
    LCD_SetWin(0, 0, LCD_W - 1, LCD_H - 1);
    for (i = 0; i < n; i++) LCD_DATA = color;
}

void LCD_ShowChar(uint16_t x, uint16_t y, uint8_t ch, uint8_t size, uint16_t color)
{
    uint8_t t, d, csize = (size / 8) * size;  /* 16→32 bytes */
    if (ch < ' ' || ch > '~') ch = ' ';
    ch -= ' ';

    LCD_SetWin(x, y, x + size / 2 - 1, y + size - 1);
    for (t = 0; t < csize; t++) {
        d = font_1608[ch][t / 2];  /* 每字节放2个像素 */
        for (uint8_t b = 0; b < 8; b++) {
            LCD_DATA = (d & 0x80) ? color : WHITE;
            d <<= 1;
        }
    }
}

void LCD_ShowString(uint16_t x, uint16_t y, uint16_t w, uint8_t size,
                    uint16_t color, uint8_t *str)
{
    uint16_t x0 = x;
    while (*str) {
        if (x > x0 + w - size / 2) { x = x0; y += size; }
        if (y > LCD_H - size) break;
        LCD_ShowChar(x, y, *str++, size, color);
        x += size / 2;
    }
}
